## conf/layer.conf
```bitbake
# We have a conf and classes directory, append to BBPATH
BBPATH .= ":${LAYERDIR}"

# We have recipes-* directories, add to BBFILES
BBFILES += " ${LAYERDIR}/recipes-*/*/*.bb  \
	     ${LAYERDIR}/recipes-*/*/*.bbappend"


BBFILE_COLLECTIONS += "backports-dunfell-layer"
BBFILE_PATTERN_backports-dunfell-layer := "^${LAYERDIR}/"
BBFILE_PRIORITY_backports-dunfell-layer = "9"

LAYERDEPENDS_backports-dunfell-layer = "core openembedded-layer "

LAYERSERIES_COMPAT_backports-dunfell-layer = "dunfell "
```
